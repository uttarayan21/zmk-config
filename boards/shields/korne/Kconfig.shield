## boards/shields/korne/Kconfig.shield
```kconfig
# Copyright (c) 2020 Pete Johanson
# SPDX-License-Identifier: MIT

config SHIELD_CORNE_LEFT
    def_bool $(shields_list_contains,korne_left)

config SHIELD_CORNE_RIGHT
    def_bool $(shields_list_contains,korne_right)

config SHIELD_CORNE_DONGLE
    def_bool $(shields_list_contains,korne_dongle)
```

## config/west.yml
```yaml
manifest:
  remotes:
    - name: zmkfirmware
      url-base: https://github.com/zmkfirmware
    - name: mctechnology17
      url-base: https://github.com/mctechnology17
  projects:
    - name: zmk
      remote: zmkfirmware
      revision: 6b44d33db2f4bad7d98e475e6f7968493b05af73 
      import: app/west.yml
    - name: zmk-nice-oled
      remote: mctechnology17
      revision: 5d7dce25735277dd6dcd8295c64e143d4f95cdfa
  self:
    path: config
```
